## components/board/Kconfig
```kconfig
menu "Sipwire board"

    comment "Defaults = reference build (docs/HARDWARE.md). -1 = not connected."

    menu "Display (ILI9341, SPI)"
        config SIPWIRE_LCD_SPI_HOST
            int "SPI host (2=SPI2, 3=SPI3)"
            range 2 3
            default 2
        config SIPWIRE_LCD_SCLK
            int "SCLK"
            default 12
        config SIPWIRE_LCD_MOSI
            int "MOSI"
            default 11
        config SIPWIRE_LCD_MISO
            int "MISO (needed for touch)"
            default 13
        config SIPWIRE_LCD_CS
            int "LCD CS"
            default 10
        config SIPWIRE_LCD_DC
            int "LCD DC"
            default 14
        config SIPWIRE_LCD_RST
            int "LCD RST"
            default 9
        config SIPWIRE_LCD_BL
            int "Backlight"
            default 8
        config SIPWIRE_LCD_BL_ACTIVE_HIGH
            bool "Backlight active high"
            default y
        config SIPWIRE_LCD_PCLK_HZ
            int "LCD SPI clock (Hz)"
            default 40000000
        config SIPWIRE_LCD_H_RES
            int "Native horizontal resolution"
            default 240
        config SIPWIRE_LCD_V_RES
            int "Native vertical resolution"
            default 320
        config SIPWIRE_LCD_BGR
            bool "Panel uses BGR order"
            default y
        config SIPWIRE_LCD_INVERT
            bool "Invert colors"
            default n
        config SIPWIRE_LCD_MIRROR_X
            bool "Mirror X"
            default y
        config SIPWIRE_LCD_MIRROR_Y
            bool "Mirror Y"
            help
                Portrait upside down: toggle both Mirror X and Mirror Y (180°).
            default n
        config SIPWIRE_LCD_SWAP_XY
            bool "Swap XY (landscape)"
            default n
        config SIPWIRE_DISPLAY_PANEL_SLEEP
            bool "Put the panel to sleep while the backlight is off"
            default y
            help
                ILI9341 SLPIN when the backlight goes off (DC/DC, oscillator and panel
                scanning stop; frame memory and the SPI interface keep working, so LVGL
                may still flush into it), SLPOUT before it comes back on. The backlight
                is switched on only 120 ms after SLPOUT, so the panel's start-up is never
                visible. No effect in the QEMU build (no panel).
    endmenu

    menu "Touch (XPT2046, shares LCD SPI bus)"
        config SIPWIRE_TOUCH_ENABLE
            bool "Touch present"
            default y
        config SIPWIRE_TOUCH_CS
            int "Touch CS"
            depends on SIPWIRE_TOUCH_ENABLE
            default 16
        config SIPWIRE_TOUCH_IRQ
            int "Touch IRQ (PENIRQ)"
            depends on SIPWIRE_TOUCH_ENABLE
            default 17
        comment "Touch axes map raw XPT2046 X/Y to the screen, independent of the panel."
        config SIPWIRE_TOUCH_SWAP_XY
            bool "Touch: swap X/Y"
            depends on SIPWIRE_TOUCH_ENABLE
            default n
        config SIPWIRE_TOUCH_MIRROR_X
            bool "Touch: mirror X"
            depends on SIPWIRE_TOUCH_ENABLE
            default n
        config SIPWIRE_TOUCH_MIRROR_Y
            bool "Touch: mirror Y"
            depends on SIPWIRE_TOUCH_ENABLE
            default y
            help
                Reference build. Touch rotated 180 degrees: toggle both mirror options.
        config SIPWIRE_TOUCH_SPI_HZ
            int "Touch SPI clock (Hz)"
            depends on SIPWIRE_TOUCH_ENABLE
            default 2000000
        config SIPWIRE_TOUCH_RELEASE_DEBOUNCE_MS
            int "Touch release debounce (ms)"
            depends on SIPWIRE_TOUCH_ENABLE
            range 0 300
            default 80
            help
                A finger counts as lifted only after the panel reported no touch for this long.
                A resistive panel drops out for a read or two (~33 ms each) when a dragging finger
                eases off; without this, that early release turns a scroll into a tap on the item
                it started on. Taps are reported this much later. 0 = off.
    endmenu

    menu "Speaker (I2S DAC + amp)"
        config SIPWIRE_SPK_BCLK
            int "BCLK"
            default 15
        config SIPWIRE_SPK_WS
            int "WS / LRCLK"
            default 7
        config SIPWIRE_SPK_DOUT
            int "DOUT"
            default 6
        config SIPWIRE_SPK_EN
            int "Amp enable / shutdown pin (MAX98357A SD_MODE)"
            default 18
            help
                Driven "on" only while an audio stream plays (call, tone, ringtone,
                until the 2 s idle stop of a tone-only stream), "off" otherwise, also
                in light sleep. Between reset and audio_init() the pin is not driven:
                if the amp breakout pulls SD_MODE up, fit an external pull-down
                (docs/HARDWARE.md).
        config SIPWIRE_SPK_EN_ACTIVE_HIGH
            bool "Amp enable active high"
            default y
    endmenu

    menu "Microphone (I2S MEMS)"
        config SIPWIRE_I2S_FULL_DUPLEX
            bool "Mic shares speaker BCLK/WS (one I2S controller)"
            default y
        config SIPWIRE_MIC_BCLK
            int "BCLK"
            depends on !SIPWIRE_I2S_FULL_DUPLEX
            default 47
        config SIPWIRE_MIC_WS
            int "WS"
            depends on !SIPWIRE_I2S_FULL_DUPLEX
            default 21
        config SIPWIRE_MIC_DIN
            int "DIN (mic SD)"
            default 5
        config SIPWIRE_MIC_SLOT_RIGHT
            bool "Mic outputs on right slot (L/R pin high)"
            default n
        config SIPWIRE_MIC_SHIFT
            int "Right shift from 32-bit sample to 16-bit"
            range 8 20
            default 14
    endmenu

    menu "Echo cancellation"
        config SIPWIRE_AEC
            bool "Acoustic echo canceller on the mic path"
            default y
            help
                Cancels the speaker-to-mic echo with SpeexDSP's echo canceller
                (vendored in components/aec: adaptive MDF filter + residual
                echo suppressor). Switched live by the `aec` setting; off, the
                mic path is untouched.
        config SIPWIRE_AEC_TAIL
            int "Echo tail (samples at 16 kHz)"
            depends on SIPWIRE_AEC
            range 320 5120
            default 1280
            help
                Echo path length the adaptive filter models, rounded up to
                whole 20 ms frames (320 samples). The reference is read 160
                samples (10 ms) ahead of the nominal speaker->mic delay, so
                the default 1280 (80 ms) covers echo up to ~70 ms after it.
                Each 320 samples costs ~7.7 KB of RAM and a little CPU; the
                FFTs, which do not depend on the tail, dominate the cost.
                Echo beyond the tail is left to the residual suppressor.
    endmenu

    menu "Keypad (3x4 matrix)"
        config SIPWIRE_KP_ROW0
            int "Row 0 (1 2 3)"
            default 39
        config SIPWIRE_KP_ROW1
            int "Row 1 (4 5 6)"
            default 1
        config SIPWIRE_KP_ROW2
            int "Row 2 (7 8 9)"
            default 2
        config SIPWIRE_KP_ROW3
            int "Row 3 (* 0 #)"
            default 41
        config SIPWIRE_KP_COL0
            int "Col 0"
            default 38
        config SIPWIRE_KP_COL1
            int "Col 1"
            default 40
        config SIPWIRE_KP_COL2
            int "Col 2"
            default 42
        config SIPWIRE_KP_MAP
            string "Key map, row-major (12 chars)"
            default "123456789*0#"
    endmenu

    menu "Status LED"
        config SIPWIRE_STATUS_LED
            int "WS2812 data pin (-1 = none)"
            default 48
    endmenu

    menu "SD card (optional)"
        config SIPWIRE_SD_ENABLE
            bool "SD card slot present"
            default n
        choice SIPWIRE_SD_MODE
            prompt "SD interface"
            depends on SIPWIRE_SD_ENABLE
            default SIPWIRE_SD_MODE_SPI
            config SIPWIRE_SD_MODE_SDMMC
                bool "SDMMC 1-bit"
            config SIPWIRE_SD_MODE_SPI
                bool "SPI (shares LCD bus)"
        endchoice
        config SIPWIRE_SD_CLK
            int "SDMMC CLK"
            depends on SIPWIRE_SD_MODE_SDMMC
            default 47
        config SIPWIRE_SD_CMD
            int "SDMMC CMD"
            depends on SIPWIRE_SD_MODE_SDMMC
            default 3
        config SIPWIRE_SD_D0
            int "SDMMC D0"
            depends on SIPWIRE_SD_MODE_SDMMC
            default 38
            help
                Defaults are placeholders. Avoid strapping pins 0, 3, 45, 46.
        config SIPWIRE_SD_CS
            int "SPI CS"
            depends on SIPWIRE_SD_MODE_SPI
            default 47
        config SIPWIRE_SD_CD
            int "Card detect (-1 = none)"
            depends on SIPWIRE_SD_ENABLE
            default -1
    endmenu

    menu "Power (components/power)"
        config SIPWIRE_WIFI_LISTEN_INTERVAL
            int "Wi-Fi listen interval while idle (beacons; 1 = every DTIM)"
            range 1 10
            default 3
            help
                Wi-Fi power save while no call exists (components/net). 1: WIFI_PS_MIN_MODEM,
                the radio wakes for every DTIM beacon. 2-10: WIFI_PS_MAX_MODEM, it wakes
                every this many beacons (the listen interval is announced to the AP when
                associating). Calls always use WIFI_PS_NONE.
                Trade-off: the AP holds an incoming INVITE until the next wake-up, so
                ringing may start up to listen interval x beacon interval later (3 x
                102.4 ms = 0.3 s; 10 = 1 s, then SIP T1 retransmits the INVITE once).
                Broadcasts (ARP requests from the PBX or router) come only at DTIM
                beacons and are missed when the listen interval skips them: keep it a
                multiple of the AP's DTIM period.
        config SIPWIRE_POWER_DFS
            bool "Dynamic CPU frequency scaling while idle"
            depends on PM_ENABLE
            default y
            help
                Run the CPU at the minimum frequency below when no call exists and
                the backlight is off; full speed otherwise. Wi-Fi modem sleep while
                idle is separate (net, SIPWIRE_WIFI_LISTEN_INTERVAL) and always on.
                Light sleep: next option (docs/ARCHITECTURE.md "Power").
        config SIPWIRE_POWER_MIN_CPU_MHZ
            int "Idle CPU frequency (MHz): 80, 160 or 240"
            depends on SIPWIRE_POWER_DFS
            range 80 240
            default 80
            help
                Not below 80: under 80 MHz the CPU runs from XTAL and APB drops to
                40 MHz, which changes the UART, LEDC (backlight PWM) and other
                APB-clocked peripherals mid-operation.
        config SIPWIRE_POWER_LIGHT_SLEEP
            bool "Automatic light sleep while idle (screen off, no call)"
            depends on SIPWIRE_POWER_DFS && FREERTOS_USE_TICKLESS_IDLE
            select PM_LIGHT_SLEEP_CALLBACKS
            default n
            help
                Off by default: on the handset (octal PSRAM), once the chip had light-slept,
                answering or ending a call sometimes crashed it (PSRAM "MMU entry fault",
                or a hang in the panic handler with the flash cache off, then a watchdog
                reset), also after `power sleep off`. Never with this option off.
                Let the chip light-sleep whenever both cores idle and nothing holds it
                awake: never during a call (ringing included), while the backlight is
                on or dimmed, or within SIPWIRE_POWER_CONSOLE_AWAKE_S of console input.
                Wi-Fi stays associated in modem sleep and wakes for each DTIM beacon, so
                an INVITE still arrives within one DTIM interval. Wake sources: keypad
                columns and touch PENIRQ (GPIO, level low), console UART RX edges (the
                characters that wake it are lost). Needs FREERTOS_USE_TICKLESS_IDLE.
        config SIPWIRE_POWER_CONSOLE_AWAKE_S
            int "Stay awake this long after console input (s)"
            depends on SIPWIRE_POWER_LIGHT_SLEEP
            range 5 3600
            default 60
            help
                A character that arrives during light sleep only wakes the chip; it
                is not received. After a UART wake-up or any console input, light
                sleep stays off for this many seconds so the rest of the line and
                the next commands get through.
    endmenu

    config SIPWIRE_QEMU
        bool "QEMU smoke-test build"
        default n
        help
            Test-only. Networking uses QEMU's OpenCores Ethernet instead of
            Wi-Fi, and audio replaces I2S with paced silence. Set by
            sdkconfig.qemu (see tools/qemu/README.md); never on hardware.

endmenu
```

## main/Kconfig.projbuild
```kconfig
menu "Sipwire app"

    config SIPWIRE_TZ
        string "Time zone (POSIX TZ string)"
        default "UTC0"
        help
            Local time zone for the status-bar clock, as a POSIX TZ string,
            e.g. "CET-1CEST,M3.5.0,M10.5.0/3" or "EST5EDT,M3.2.0,M11.1.0".

    config SIPWIRE_NTP_SERVER
        string "NTP server"
        default "pool.ntp.org"
        help
            SNTP server used to set the clock after the first Wi-Fi connection.

    config SIPWIRE_OTA_URL
        string "Default firmware update URL"
        default "http://192.168.2.154:8090/ota.bin"
        help
            Where `ota` and Settings > Update fetch the new sipwire.bin from
            unless another URL is stored (`cfg set ota_url`). Plain http works
            (CONFIG_ESP_HTTPS_OTA_ALLOW_HTTP is enabled): keep it on a trusted LAN.

endmenu
```
